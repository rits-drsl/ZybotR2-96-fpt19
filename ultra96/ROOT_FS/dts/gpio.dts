/dts-v1/;
/plugin/;
/ {
	fragment@0 {
		target-path = "/amba";
		__overlay__ {
			#address-cells = <2>;
			#size-cells = <2>;
			uart_sync_memory_interface_axi_gpio_0: gpio@a0012000 {
				compatible = "generic-uio";
				reg = <0x0 0xa0012000 0x0 0x1000>;
			};
			uart_sync_memory_interface_axi_gpio_1: gpio@a0013000 {
				compatible = "generic-uio";
				reg = <0x0 0xa0013000 0x0 0x1000>;
			};
		};
	};
};